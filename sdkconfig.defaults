## sdkconfig.defaults
```kconfig
#
# Base defaults adapted from esp-iot-bridge/examples/4g_nic.
#

#
# Serial flasher config
#
CONFIG_ESPTOOLPY_FLASHSIZE_4MB=y

#
# Partition Table
#
CONFIG_PARTITION_TABLE_TWO_OTA=y

# Temporary fix for timer overflows in bridge example
CONFIG_FREERTOS_TIMER_TASK_STACK_DEPTH=4096

#
# LWIP
#
CONFIG_LWIP_L2_TO_L3_COPY=y
CONFIG_LWIP_IP_FORWARD=y
CONFIG_LWIP_IPV4_NAPT=y
CONFIG_LWIP_TCP_MSS=1460
CONFIG_LWIP_TCP_OVERSIZE_MSS=y
CONFIG_LWIP_TCPIP_TASK_STACK_SIZE=4096

# Enable PPP for modem uplink
CONFIG_LWIP_PPP_SUPPORT=y
CONFIG_LWIP_PPP_PAP_SUPPORT=y
CONFIG_LWIP_PPP_ENABLE_IPV6=n

CONFIG_ETH_DMA_BUFFER_SIZE=1600
CONFIG_ETH_SPI_ETHERNET_W5500=y

CONFIG_ESP_MAIN_TASK_STACK_SIZE=5120

#
# ESP-IoT-Bridge mode: modem as WAN, Ethernet as forwarding interface
#
CONFIG_BRIDGE_EXTERNAL_NETIF_STATION=n
CONFIG_BRIDGE_EXTERNAL_NETIF_MODEM=y
CONFIG_BRIDGE_DATA_FORWARDING_NETIF_SOFTAP=n
CONFIG_BRIDGE_DATA_FORWARDING_NETIF_ETHERNET=y
CONFIG_BRIDGE_MODEM_USB_VID=0x2ecc
CONFIG_BRIDGE_MODEM_USB_PID=0x3012
CONFIG_BRIDGE_MODEM_USB_INTERFACE_NUMBER=1
```
